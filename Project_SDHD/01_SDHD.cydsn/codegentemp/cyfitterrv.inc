;
; File Name: cyfitterrv.inc
; 
; PSoC Creator  4.2
;
; Description:
; 
;
;-------------------------------------------------------------------------------
; Copyright (c) 2007-2018 Cypress Semiconductor.  All rights reserved.
; You may use this file only in accordance with the license, terms, conditions, 
; disclaimers, and limitations in the end user license agreement accompanying 
; the software package with which this file was provided.
;-------------------------------------------------------------------------------

    IF :LNOT::DEF:INCLUDED_CYFITTERRV_INC
INCLUDED_CYFITTERRV_INC EQU 1
    GET cydevicerv.inc
    GET cydevicerv_trm.inc

; DMA
DMA__DRQ_CTL EQU CYREG_IDMUX_DRQ_CTL2
DMA__DRQ_NUMBER EQU 10
DMA__NUMBEROF_TDS EQU 0
DMA__PRIORITY EQU 2
DMA__TERMIN_EN EQU 0
DMA__TERMIN_SEL EQU 0
DMA__TERMOUT0_EN EQU 1
DMA__TERMOUT0_SEL EQU 10
DMA__TERMOUT1_EN EQU 0
DMA__TERMOUT1_SEL EQU 0
DMA_CHANNELS_USED__MASK0 EQU 0x00000403

; Rx_1
Rx_1__0__INTTYPE EQU CYREG_PICU2_INTTYPE0
Rx_1__0__MASK EQU 0x01
Rx_1__0__PC EQU CYREG_PRT2_PC0
Rx_1__0__PORT EQU 2
Rx_1__0__SHIFT EQU 0
Rx_1__AG EQU CYREG_PRT2_AG
Rx_1__AMUX EQU CYREG_PRT2_AMUX
Rx_1__BIE EQU CYREG_PRT2_BIE
Rx_1__BIT_MASK EQU CYREG_PRT2_BIT_MASK
Rx_1__BYP EQU CYREG_PRT2_BYP
Rx_1__CTL EQU CYREG_PRT2_CTL
Rx_1__DM0 EQU CYREG_PRT2_DM0
Rx_1__DM1 EQU CYREG_PRT2_DM1
Rx_1__DM2 EQU CYREG_PRT2_DM2
Rx_1__DR EQU CYREG_PRT2_DR
Rx_1__INP_DIS EQU CYREG_PRT2_INP_DIS
Rx_1__INTTYPE_BASE EQU CYDEV_PICU_INTTYPE_PICU2_BASE
Rx_1__LCD_COM_SEG EQU CYREG_PRT2_LCD_COM_SEG
Rx_1__LCD_EN EQU CYREG_PRT2_LCD_EN
Rx_1__MASK EQU 0x01
Rx_1__PORT EQU 2
Rx_1__PRT EQU CYREG_PRT2_PRT
Rx_1__PRTDSI__CAPS_SEL EQU CYREG_PRT2_CAPS_SEL
Rx_1__PRTDSI__DBL_SYNC_IN EQU CYREG_PRT2_DBL_SYNC_IN
Rx_1__PRTDSI__OE_SEL0 EQU CYREG_PRT2_OE_SEL0
Rx_1__PRTDSI__OE_SEL1 EQU CYREG_PRT2_OE_SEL1
Rx_1__PRTDSI__OUT_SEL0 EQU CYREG_PRT2_OUT_SEL0
Rx_1__PRTDSI__OUT_SEL1 EQU CYREG_PRT2_OUT_SEL1
Rx_1__PRTDSI__SYNC_OUT EQU CYREG_PRT2_SYNC_OUT
Rx_1__PS EQU CYREG_PRT2_PS
Rx_1__SHIFT EQU 0
Rx_1__SLW EQU CYREG_PRT2_SLW

; Tx_1
Tx_1__0__INTTYPE EQU CYREG_PICU2_INTTYPE1
Tx_1__0__MASK EQU 0x02
Tx_1__0__PC EQU CYREG_PRT2_PC1
Tx_1__0__PORT EQU 2
Tx_1__0__SHIFT EQU 1
Tx_1__AG EQU CYREG_PRT2_AG
Tx_1__AMUX EQU CYREG_PRT2_AMUX
Tx_1__BIE EQU CYREG_PRT2_BIE
Tx_1__BIT_MASK EQU CYREG_PRT2_BIT_MASK
Tx_1__BYP EQU CYREG_PRT2_BYP
Tx_1__CTL EQU CYREG_PRT2_CTL
Tx_1__DM0 EQU CYREG_PRT2_DM0
Tx_1__DM1 EQU CYREG_PRT2_DM1
Tx_1__DM2 EQU CYREG_PRT2_DM2
Tx_1__DR EQU CYREG_PRT2_DR
Tx_1__INP_DIS EQU CYREG_PRT2_INP_DIS
Tx_1__INTTYPE_BASE EQU CYDEV_PICU_INTTYPE_PICU2_BASE
Tx_1__LCD_COM_SEG EQU CYREG_PRT2_LCD_COM_SEG
Tx_1__LCD_EN EQU CYREG_PRT2_LCD_EN
Tx_1__MASK EQU 0x02
Tx_1__PORT EQU 2
Tx_1__PRT EQU CYREG_PRT2_PRT
Tx_1__PRTDSI__CAPS_SEL EQU CYREG_PRT2_CAPS_SEL
Tx_1__PRTDSI__DBL_SYNC_IN EQU CYREG_PRT2_DBL_SYNC_IN
Tx_1__PRTDSI__OE_SEL0 EQU CYREG_PRT2_OE_SEL0
Tx_1__PRTDSI__OE_SEL1 EQU CYREG_PRT2_OE_SEL1
Tx_1__PRTDSI__OUT_SEL0 EQU CYREG_PRT2_OUT_SEL0
Tx_1__PRTDSI__OUT_SEL1 EQU CYREG_PRT2_OUT_SEL1
Tx_1__PRTDSI__SYNC_OUT EQU CYREG_PRT2_SYNC_OUT
Tx_1__PS EQU CYREG_PRT2_PS
Tx_1__SHIFT EQU 1
Tx_1__SLW EQU CYREG_PRT2_SLW

; UART
UART_BUART_sRX_RxBitCounter__CONTROL_AUX_CTL_REG EQU CYREG_B0_UDB15_ACTL
UART_BUART_sRX_RxBitCounter__CONTROL_REG EQU CYREG_B0_UDB15_CTL
UART_BUART_sRX_RxBitCounter__CONTROL_ST_REG EQU CYREG_B0_UDB15_ST_CTL
UART_BUART_sRX_RxBitCounter__COUNT_REG EQU CYREG_B0_UDB15_CTL
UART_BUART_sRX_RxBitCounter__COUNT_ST_REG EQU CYREG_B0_UDB15_ST_CTL
UART_BUART_sRX_RxBitCounter__MASK_CTL_AUX_CTL_REG EQU CYREG_B0_UDB15_MSK_ACTL
UART_BUART_sRX_RxBitCounter__PER_CTL_AUX_CTL_REG EQU CYREG_B0_UDB15_MSK_ACTL
UART_BUART_sRX_RxBitCounter__PERIOD_REG EQU CYREG_B0_UDB15_MSK
UART_BUART_sRX_RxBitCounter_ST__MASK_REG EQU CYREG_B0_UDB15_MSK
UART_BUART_sRX_RxBitCounter_ST__MASK_ST_AUX_CTL_REG EQU CYREG_B0_UDB15_MSK_ACTL
UART_BUART_sRX_RxBitCounter_ST__PER_ST_AUX_CTL_REG EQU CYREG_B0_UDB15_MSK_ACTL
UART_BUART_sRX_RxBitCounter_ST__STATUS_AUX_CTL_REG EQU CYREG_B0_UDB15_ACTL
UART_BUART_sRX_RxBitCounter_ST__STATUS_CNT_REG EQU CYREG_B0_UDB15_ST_CTL
UART_BUART_sRX_RxBitCounter_ST__STATUS_CONTROL_REG EQU CYREG_B0_UDB15_ST_CTL
UART_BUART_sRX_RxBitCounter_ST__STATUS_REG EQU CYREG_B0_UDB15_ST
UART_BUART_sRX_RxShifter_u0__16BIT_A0_REG EQU CYREG_B0_UDB12_13_A0
UART_BUART_sRX_RxShifter_u0__16BIT_A1_REG EQU CYREG_B0_UDB12_13_A1
UART_BUART_sRX_RxShifter_u0__16BIT_D0_REG EQU CYREG_B0_UDB12_13_D0
UART_BUART_sRX_RxShifter_u0__16BIT_D1_REG EQU CYREG_B0_UDB12_13_D1
UART_BUART_sRX_RxShifter_u0__16BIT_DP_AUX_CTL_REG EQU CYREG_B0_UDB12_13_ACTL
UART_BUART_sRX_RxShifter_u0__16BIT_F0_REG EQU CYREG_B0_UDB12_13_F0
UART_BUART_sRX_RxShifter_u0__16BIT_F1_REG EQU CYREG_B0_UDB12_13_F1
UART_BUART_sRX_RxShifter_u0__A0_A1_REG EQU CYREG_B0_UDB12_A0_A1
UART_BUART_sRX_RxShifter_u0__A0_REG EQU CYREG_B0_UDB12_A0
UART_BUART_sRX_RxShifter_u0__A1_REG EQU CYREG_B0_UDB12_A1
UART_BUART_sRX_RxShifter_u0__D0_D1_REG EQU CYREG_B0_UDB12_D0_D1
UART_BUART_sRX_RxShifter_u0__D0_REG EQU CYREG_B0_UDB12_D0
UART_BUART_sRX_RxShifter_u0__D1_REG EQU CYREG_B0_UDB12_D1
UART_BUART_sRX_RxShifter_u0__DP_AUX_CTL_REG EQU CYREG_B0_UDB12_ACTL
UART_BUART_sRX_RxShifter_u0__F0_F1_REG EQU CYREG_B0_UDB12_F0_F1
UART_BUART_sRX_RxShifter_u0__F0_REG EQU CYREG_B0_UDB12_F0
UART_BUART_sRX_RxShifter_u0__F1_REG EQU CYREG_B0_UDB12_F1
UART_BUART_sRX_RxSts__16BIT_STATUS_AUX_CTL_REG EQU CYREG_B0_UDB12_13_ACTL
UART_BUART_sRX_RxSts__16BIT_STATUS_REG EQU CYREG_B0_UDB12_13_ST
UART_BUART_sRX_RxSts__3__MASK EQU 0x08
UART_BUART_sRX_RxSts__3__POS EQU 3
UART_BUART_sRX_RxSts__4__MASK EQU 0x10
UART_BUART_sRX_RxSts__4__POS EQU 4
UART_BUART_sRX_RxSts__5__MASK EQU 0x20
UART_BUART_sRX_RxSts__5__POS EQU 5
UART_BUART_sRX_RxSts__MASK EQU 0x38
UART_BUART_sRX_RxSts__MASK_REG EQU CYREG_B0_UDB12_MSK
UART_BUART_sRX_RxSts__STATUS_AUX_CTL_REG EQU CYREG_B0_UDB12_ACTL
UART_BUART_sRX_RxSts__STATUS_REG EQU CYREG_B0_UDB12_ST
UART_BUART_sTX_sCLOCK_TxBitClkGen__16BIT_A0_REG EQU CYREG_B0_UDB11_12_A0
UART_BUART_sTX_sCLOCK_TxBitClkGen__16BIT_A1_REG EQU CYREG_B0_UDB11_12_A1
UART_BUART_sTX_sCLOCK_TxBitClkGen__16BIT_D0_REG EQU CYREG_B0_UDB11_12_D0
UART_BUART_sTX_sCLOCK_TxBitClkGen__16BIT_D1_REG EQU CYREG_B0_UDB11_12_D1
UART_BUART_sTX_sCLOCK_TxBitClkGen__16BIT_DP_AUX_CTL_REG EQU CYREG_B0_UDB11_12_ACTL
UART_BUART_sTX_sCLOCK_TxBitClkGen__16BIT_F0_REG EQU CYREG_B0_UDB11_12_F0
UART_BUART_sTX_sCLOCK_TxBitClkGen__16BIT_F1_REG EQU CYREG_B0_UDB11_12_F1
UART_BUART_sTX_sCLOCK_TxBitClkGen__A0_A1_REG EQU CYREG_B0_UDB11_A0_A1
UART_BUART_sTX_sCLOCK_TxBitClkGen__A0_REG EQU CYREG_B0_UDB11_A0
UART_BUART_sTX_sCLOCK_TxBitClkGen__A1_REG EQU CYREG_B0_UDB11_A1
UART_BUART_sTX_sCLOCK_TxBitClkGen__D0_D1_REG EQU CYREG_B0_UDB11_D0_D1
UART_BUART_sTX_sCLOCK_TxBitClkGen__D0_REG EQU CYREG_B0_UDB11_D0
UART_BUART_sTX_sCLOCK_TxBitClkGen__D1_REG EQU CYREG_B0_UDB11_D1
UART_BUART_sTX_sCLOCK_TxBitClkGen__DP_AUX_CTL_REG EQU CYREG_B0_UDB11_ACTL
UART_BUART_sTX_sCLOCK_TxBitClkGen__F0_F1_REG EQU CYREG_B0_UDB11_F0_F1
UART_BUART_sTX_sCLOCK_TxBitClkGen__F0_REG EQU CYREG_B0_UDB11_F0
UART_BUART_sTX_sCLOCK_TxBitClkGen__F1_REG EQU CYREG_B0_UDB11_F1
UART_BUART_sTX_TxShifter_u0__16BIT_A0_REG EQU CYREG_B0_UDB10_11_A0
UART_BUART_sTX_TxShifter_u0__16BIT_A1_REG EQU CYREG_B0_UDB10_11_A1
UART_BUART_sTX_TxShifter_u0__16BIT_D0_REG EQU CYREG_B0_UDB10_11_D0
UART_BUART_sTX_TxShifter_u0__16BIT_D1_REG EQU CYREG_B0_UDB10_11_D1
UART_BUART_sTX_TxShifter_u0__16BIT_DP_AUX_CTL_REG EQU CYREG_B0_UDB10_11_ACTL
UART_BUART_sTX_TxShifter_u0__16BIT_F0_REG EQU CYREG_B0_UDB10_11_F0
UART_BUART_sTX_TxShifter_u0__16BIT_F1_REG EQU CYREG_B0_UDB10_11_F1
UART_BUART_sTX_TxShifter_u0__A0_A1_REG EQU CYREG_B0_UDB10_A0_A1
UART_BUART_sTX_TxShifter_u0__A0_REG EQU CYREG_B0_UDB10_A0
UART_BUART_sTX_TxShifter_u0__A1_REG EQU CYREG_B0_UDB10_A1
UART_BUART_sTX_TxShifter_u0__D0_D1_REG EQU CYREG_B0_UDB10_D0_D1
UART_BUART_sTX_TxShifter_u0__D0_REG EQU CYREG_B0_UDB10_D0
UART_BUART_sTX_TxShifter_u0__D1_REG EQU CYREG_B0_UDB10_D1
UART_BUART_sTX_TxShifter_u0__DP_AUX_CTL_REG EQU CYREG_B0_UDB10_ACTL
UART_BUART_sTX_TxShifter_u0__F0_F1_REG EQU CYREG_B0_UDB10_F0_F1
UART_BUART_sTX_TxShifter_u0__F0_REG EQU CYREG_B0_UDB10_F0
UART_BUART_sTX_TxShifter_u0__F1_REG EQU CYREG_B0_UDB10_F1
UART_BUART_sTX_TxSts__0__MASK EQU 0x01
UART_BUART_sTX_TxSts__0__POS EQU 0
UART_BUART_sTX_TxSts__1__MASK EQU 0x02
UART_BUART_sTX_TxSts__1__POS EQU 1
UART_BUART_sTX_TxSts__16BIT_STATUS_AUX_CTL_REG EQU CYREG_B0_UDB13_14_ACTL
UART_BUART_sTX_TxSts__16BIT_STATUS_REG EQU CYREG_B0_UDB13_14_ST
UART_BUART_sTX_TxSts__2__MASK EQU 0x04
UART_BUART_sTX_TxSts__2__POS EQU 2
UART_BUART_sTX_TxSts__3__MASK EQU 0x08
UART_BUART_sTX_TxSts__3__POS EQU 3
UART_BUART_sTX_TxSts__MASK EQU 0x0F
UART_BUART_sTX_TxSts__MASK_REG EQU CYREG_B0_UDB13_MSK
UART_BUART_sTX_TxSts__STATUS_AUX_CTL_REG EQU CYREG_B0_UDB13_ACTL
UART_BUART_sTX_TxSts__STATUS_REG EQU CYREG_B0_UDB13_ST
UART_IntClock__CFG0 EQU CYREG_CLKDIST_DCFG1_CFG0
UART_IntClock__CFG1 EQU CYREG_CLKDIST_DCFG1_CFG1
UART_IntClock__CFG2 EQU CYREG_CLKDIST_DCFG1_CFG2
UART_IntClock__CFG2_SRC_SEL_MASK EQU 0x07
UART_IntClock__INDEX EQU 0x01
UART_IntClock__PM_ACT_CFG EQU CYREG_PM_ACT_CFG2
UART_IntClock__PM_ACT_MSK EQU 0x02
UART_IntClock__PM_STBY_CFG EQU CYREG_PM_STBY_CFG2
UART_IntClock__PM_STBY_MSK EQU 0x02
UART_TXInternalInterrupt__INTC_CLR_EN_REG EQU CYREG_NVIC_CLRENA0
UART_TXInternalInterrupt__INTC_CLR_PD_REG EQU CYREG_NVIC_CLRPEND0
UART_TXInternalInterrupt__INTC_MASK EQU 0x04
UART_TXInternalInterrupt__INTC_NUMBER EQU 2
UART_TXInternalInterrupt__INTC_PRIOR_NUM EQU 7
UART_TXInternalInterrupt__INTC_PRIOR_REG EQU CYREG_NVIC_PRI_2
UART_TXInternalInterrupt__INTC_SET_EN_REG EQU CYREG_NVIC_SETENA0
UART_TXInternalInterrupt__INTC_SET_PD_REG EQU CYREG_NVIC_SETPEND0

; Pin_1
Pin_1__0__INTTYPE EQU CYREG_PICU15_INTTYPE4
Pin_1__0__MASK EQU 0x10
Pin_1__0__PC EQU CYREG_IO_PC_PRT15_PC4
Pin_1__0__PORT EQU 15
Pin_1__0__SHIFT EQU 4
Pin_1__AG EQU CYREG_PRT15_AG
Pin_1__AMUX EQU CYREG_PRT15_AMUX
Pin_1__BIE EQU CYREG_PRT15_BIE
Pin_1__BIT_MASK EQU CYREG_PRT15_BIT_MASK
Pin_1__BYP EQU CYREG_PRT15_BYP
Pin_1__CTL EQU CYREG_PRT15_CTL
Pin_1__DM0 EQU CYREG_PRT15_DM0
Pin_1__DM1 EQU CYREG_PRT15_DM1
Pin_1__DM2 EQU CYREG_PRT15_DM2
Pin_1__DR EQU CYREG_PRT15_DR
Pin_1__INP_DIS EQU CYREG_PRT15_INP_DIS
Pin_1__INTTYPE_BASE EQU CYDEV_PICU_INTTYPE_PICU15_BASE
Pin_1__LCD_COM_SEG EQU CYREG_PRT15_LCD_COM_SEG
Pin_1__LCD_EN EQU CYREG_PRT15_LCD_EN
Pin_1__MASK EQU 0x10
Pin_1__PORT EQU 15
Pin_1__PRT EQU CYREG_PRT15_PRT
Pin_1__PRTDSI__CAPS_SEL EQU CYREG_PRT15_CAPS_SEL
Pin_1__PRTDSI__DBL_SYNC_IN EQU CYREG_PRT15_DBL_SYNC_IN
Pin_1__PRTDSI__OE_SEL0 EQU CYREG_PRT15_OE_SEL0
Pin_1__PRTDSI__OE_SEL1 EQU CYREG_PRT15_OE_SEL1
Pin_1__PRTDSI__OUT_SEL0 EQU CYREG_PRT15_OUT_SEL0
Pin_1__PRTDSI__OUT_SEL1 EQU CYREG_PRT15_OUT_SEL1
Pin_1__PRTDSI__SYNC_OUT EQU CYREG_PRT15_SYNC_OUT
Pin_1__PS EQU CYREG_PRT15_PS
Pin_1__SHIFT EQU 4
Pin_1__SLW EQU CYREG_PRT15_SLW

; Pin_2
Pin_2__0__INTTYPE EQU CYREG_PICU15_INTTYPE5
Pin_2__0__MASK EQU 0x20
Pin_2__0__PC EQU CYREG_IO_PC_PRT15_PC5
Pin_2__0__PORT EQU 15
Pin_2__0__SHIFT EQU 5
Pin_2__AG EQU CYREG_PRT15_AG
Pin_2__AMUX EQU CYREG_PRT15_AMUX
Pin_2__BIE EQU CYREG_PRT15_BIE
Pin_2__BIT_MASK EQU CYREG_PRT15_BIT_MASK
Pin_2__BYP EQU CYREG_PRT15_BYP
Pin_2__CTL EQU CYREG_PRT15_CTL
Pin_2__DM0 EQU CYREG_PRT15_DM0
Pin_2__DM1 EQU CYREG_PRT15_DM1
Pin_2__DM2 EQU CYREG_PRT15_DM2
Pin_2__DR EQU CYREG_PRT15_DR
Pin_2__INP_DIS EQU CYREG_PRT15_INP_DIS
Pin_2__INTTYPE_BASE EQU CYDEV_PICU_INTTYPE_PICU15_BASE
Pin_2__LCD_COM_SEG EQU CYREG_PRT15_LCD_COM_SEG
Pin_2__LCD_EN EQU CYREG_PRT15_LCD_EN
Pin_2__MASK EQU 0x20
Pin_2__PORT EQU 15
Pin_2__PRT EQU CYREG_PRT15_PRT
Pin_2__PRTDSI__CAPS_SEL EQU CYREG_PRT15_CAPS_SEL
Pin_2__PRTDSI__DBL_SYNC_IN EQU CYREG_PRT15_DBL_SYNC_IN
Pin_2__PRTDSI__OE_SEL0 EQU CYREG_PRT15_OE_SEL0
Pin_2__PRTDSI__OE_SEL1 EQU CYREG_PRT15_OE_SEL1
Pin_2__PRTDSI__OUT_SEL0 EQU CYREG_PRT15_OUT_SEL0
Pin_2__PRTDSI__OUT_SEL1 EQU CYREG_PRT15_OUT_SEL1
Pin_2__PRTDSI__SYNC_OUT EQU CYREG_PRT15_SYNC_OUT
Pin_2__PS EQU CYREG_PRT15_PS
Pin_2__SHIFT EQU 5
Pin_2__SLW EQU CYREG_PRT15_SLW

; ISR_PB
ISR_PB__INTC_CLR_EN_REG EQU CYREG_NVIC_CLRENA0
ISR_PB__INTC_CLR_PD_REG EQU CYREG_NVIC_CLRPEND0
ISR_PB__INTC_MASK EQU 0x40
ISR_PB__INTC_NUMBER EQU 6
ISR_PB__INTC_PRIOR_NUM EQU 7
ISR_PB__INTC_PRIOR_REG EQU CYREG_NVIC_PRI_6
ISR_PB__INTC_SET_EN_REG EQU CYREG_NVIC_SETENA0
ISR_PB__INTC_SET_PD_REG EQU CYREG_NVIC_SETPEND0

; Pin_PB
Pin_PB__0__INTTYPE EQU CYREG_PICU2_INTTYPE4
Pin_PB__0__MASK EQU 0x10
Pin_PB__0__PC EQU CYREG_PRT2_PC4
Pin_PB__0__PORT EQU 2
Pin_PB__0__SHIFT EQU 4
Pin_PB__AG EQU CYREG_PRT2_AG
Pin_PB__AMUX EQU CYREG_PRT2_AMUX
Pin_PB__BIE EQU CYREG_PRT2_BIE
Pin_PB__BIT_MASK EQU CYREG_PRT2_BIT_MASK
Pin_PB__BYP EQU CYREG_PRT2_BYP
Pin_PB__CTL EQU CYREG_PRT2_CTL
Pin_PB__DM0 EQU CYREG_PRT2_DM0
Pin_PB__DM1 EQU CYREG_PRT2_DM1
Pin_PB__DM2 EQU CYREG_PRT2_DM2
Pin_PB__DR EQU CYREG_PRT2_DR
Pin_PB__INP_DIS EQU CYREG_PRT2_INP_DIS
Pin_PB__INTSTAT EQU CYREG_PICU2_INTSTAT
Pin_PB__INTTYPE_BASE EQU CYDEV_PICU_INTTYPE_PICU2_BASE
Pin_PB__LCD_COM_SEG EQU CYREG_PRT2_LCD_COM_SEG
Pin_PB__LCD_EN EQU CYREG_PRT2_LCD_EN
Pin_PB__MASK EQU 0x10
Pin_PB__PORT EQU 2
Pin_PB__PRT EQU CYREG_PRT2_PRT
Pin_PB__PRTDSI__CAPS_SEL EQU CYREG_PRT2_CAPS_SEL
Pin_PB__PRTDSI__DBL_SYNC_IN EQU CYREG_PRT2_DBL_SYNC_IN
Pin_PB__PRTDSI__OE_SEL0 EQU CYREG_PRT2_OE_SEL0
Pin_PB__PRTDSI__OE_SEL1 EQU CYREG_PRT2_OE_SEL1
Pin_PB__PRTDSI__OUT_SEL0 EQU CYREG_PRT2_OUT_SEL0
Pin_PB__PRTDSI__OUT_SEL1 EQU CYREG_PRT2_OUT_SEL1
Pin_PB__PRTDSI__SYNC_OUT EQU CYREG_PRT2_SYNC_OUT
Pin_PB__PS EQU CYREG_PRT2_PS
Pin_PB__SHIFT EQU 4
Pin_PB__SLW EQU CYREG_PRT2_SLW
Pin_PB__SNAP EQU CYREG_PICU2_SNAP

; ISR_DMA
ISR_DMA__INTC_CLR_EN_REG EQU CYREG_NVIC_CLRENA0
ISR_DMA__INTC_CLR_PD_REG EQU CYREG_NVIC_CLRPEND0
ISR_DMA__INTC_MASK EQU 0x01
ISR_DMA__INTC_NUMBER EQU 0
ISR_DMA__INTC_PRIOR_NUM EQU 7
ISR_DMA__INTC_PRIOR_REG EQU CYREG_NVIC_PRI_0
ISR_DMA__INTC_SET_EN_REG EQU CYREG_NVIC_SETENA0
ISR_DMA__INTC_SET_PD_REG EQU CYREG_NVIC_SETPEND0

; ISR_UART
ISR_UART__INTC_CLR_EN_REG EQU CYREG_NVIC_CLRENA0
ISR_UART__INTC_CLR_PD_REG EQU CYREG_NVIC_CLRPEND0
ISR_UART__INTC_MASK EQU 0x02
ISR_UART__INTC_NUMBER EQU 1
ISR_UART__INTC_PRIOR_NUM EQU 7
ISR_UART__INTC_PRIOR_REG EQU CYREG_NVIC_PRI_1
ISR_UART__INTC_SET_EN_REG EQU CYREG_NVIC_SETENA0
ISR_UART__INTC_SET_PD_REG EQU CYREG_NVIC_SETPEND0

; WaveDAC8
WaveDAC8_DacClk__CFG0 EQU CYREG_CLKDIST_DCFG2_CFG0
WaveDAC8_DacClk__CFG1 EQU CYREG_CLKDIST_DCFG2_CFG1
WaveDAC8_DacClk__CFG2 EQU CYREG_CLKDIST_DCFG2_CFG2
WaveDAC8_DacClk__CFG2_SRC_SEL_MASK EQU 0x07
WaveDAC8_DacClk__INDEX EQU 0x02
WaveDAC8_DacClk__PM_ACT_CFG EQU CYREG_PM_ACT_CFG2
WaveDAC8_DacClk__PM_ACT_MSK EQU 0x04
WaveDAC8_DacClk__PM_STBY_CFG EQU CYREG_PM_STBY_CFG2
WaveDAC8_DacClk__PM_STBY_MSK EQU 0x04
WaveDAC8_VDAC8_viDAC8__CR0 EQU CYREG_DAC0_CR0
WaveDAC8_VDAC8_viDAC8__CR1 EQU CYREG_DAC0_CR1
WaveDAC8_VDAC8_viDAC8__D EQU CYREG_DAC0_D
WaveDAC8_VDAC8_viDAC8__PM_ACT_CFG EQU CYREG_PM_ACT_CFG8
WaveDAC8_VDAC8_viDAC8__PM_ACT_MSK EQU 0x01
WaveDAC8_VDAC8_viDAC8__PM_STBY_CFG EQU CYREG_PM_STBY_CFG8
WaveDAC8_VDAC8_viDAC8__PM_STBY_MSK EQU 0x01
WaveDAC8_VDAC8_viDAC8__STROBE EQU CYREG_DAC0_STROBE
WaveDAC8_VDAC8_viDAC8__SW0 EQU CYREG_DAC0_SW0
WaveDAC8_VDAC8_viDAC8__SW2 EQU CYREG_DAC0_SW2
WaveDAC8_VDAC8_viDAC8__SW3 EQU CYREG_DAC0_SW3
WaveDAC8_VDAC8_viDAC8__SW4 EQU CYREG_DAC0_SW4
WaveDAC8_VDAC8_viDAC8__TR EQU CYREG_DAC0_TR
WaveDAC8_VDAC8_viDAC8__TRIM__M1 EQU CYREG_FLSHID_CUST_TABLES_DAC0_M1
WaveDAC8_VDAC8_viDAC8__TRIM__M2 EQU CYREG_FLSHID_CUST_TABLES_DAC0_M2
WaveDAC8_VDAC8_viDAC8__TRIM__M3 EQU CYREG_FLSHID_CUST_TABLES_DAC0_M3
WaveDAC8_VDAC8_viDAC8__TRIM__M4 EQU CYREG_FLSHID_CUST_TABLES_DAC0_M4
WaveDAC8_VDAC8_viDAC8__TRIM__M5 EQU CYREG_FLSHID_CUST_TABLES_DAC0_M5
WaveDAC8_VDAC8_viDAC8__TRIM__M6 EQU CYREG_FLSHID_CUST_TABLES_DAC0_M6
WaveDAC8_VDAC8_viDAC8__TRIM__M7 EQU CYREG_FLSHID_CUST_TABLES_DAC0_M7
WaveDAC8_VDAC8_viDAC8__TRIM__M8 EQU CYREG_FLSHID_CUST_TABLES_DAC0_M8
WaveDAC8_VDAC8_viDAC8__TST EQU CYREG_DAC0_TST
WaveDAC8_Wave1_DMA__DRQ_CTL EQU CYREG_IDMUX_DRQ_CTL0
WaveDAC8_Wave1_DMA__DRQ_NUMBER EQU 0
WaveDAC8_Wave1_DMA__NUMBEROF_TDS EQU 0
WaveDAC8_Wave1_DMA__PRIORITY EQU 2
WaveDAC8_Wave1_DMA__TERMIN_EN EQU 0
WaveDAC8_Wave1_DMA__TERMIN_SEL EQU 0
WaveDAC8_Wave1_DMA__TERMOUT0_EN EQU 0
WaveDAC8_Wave1_DMA__TERMOUT0_SEL EQU 0
WaveDAC8_Wave1_DMA__TERMOUT1_EN EQU 0
WaveDAC8_Wave1_DMA__TERMOUT1_SEL EQU 0
WaveDAC8_Wave2_DMA__DRQ_CTL EQU CYREG_IDMUX_DRQ_CTL0
WaveDAC8_Wave2_DMA__DRQ_NUMBER EQU 1
WaveDAC8_Wave2_DMA__NUMBEROF_TDS EQU 0
WaveDAC8_Wave2_DMA__PRIORITY EQU 2
WaveDAC8_Wave2_DMA__TERMIN_EN EQU 0
WaveDAC8_Wave2_DMA__TERMIN_SEL EQU 0
WaveDAC8_Wave2_DMA__TERMOUT0_EN EQU 0
WaveDAC8_Wave2_DMA__TERMOUT0_SEL EQU 0
WaveDAC8_Wave2_DMA__TERMOUT1_EN EQU 0
WaveDAC8_Wave2_DMA__TERMOUT1_SEL EQU 0

; ADC_DelSig
ADC_DelSig_DEC__COHER EQU CYREG_DEC_COHER
ADC_DelSig_DEC__CR EQU CYREG_DEC_CR
ADC_DelSig_DEC__DR1 EQU CYREG_DEC_DR1
ADC_DelSig_DEC__DR2 EQU CYREG_DEC_DR2
ADC_DelSig_DEC__DR2H EQU CYREG_DEC_DR2H
ADC_DelSig_DEC__GCOR EQU CYREG_DEC_GCOR
ADC_DelSig_DEC__GCORH EQU CYREG_DEC_GCORH
ADC_DelSig_DEC__GVAL EQU CYREG_DEC_GVAL
ADC_DelSig_DEC__OCOR EQU CYREG_DEC_OCOR
ADC_DelSig_DEC__OCORH EQU CYREG_DEC_OCORH
ADC_DelSig_DEC__OCORM EQU CYREG_DEC_OCORM
ADC_DelSig_DEC__OUTSAMP EQU CYREG_DEC_OUTSAMP
ADC_DelSig_DEC__OUTSAMPH EQU CYREG_DEC_OUTSAMPH
ADC_DelSig_DEC__OUTSAMPM EQU CYREG_DEC_OUTSAMPM
ADC_DelSig_DEC__OUTSAMPS EQU CYREG_DEC_OUTSAMPS
ADC_DelSig_DEC__PM_ACT_CFG EQU CYREG_PM_ACT_CFG10
ADC_DelSig_DEC__PM_ACT_MSK EQU 0x01
ADC_DelSig_DEC__PM_STBY_CFG EQU CYREG_PM_STBY_CFG10
ADC_DelSig_DEC__PM_STBY_MSK EQU 0x01
ADC_DelSig_DEC__SHIFT1 EQU CYREG_DEC_SHIFT1
ADC_DelSig_DEC__SHIFT2 EQU CYREG_DEC_SHIFT2
ADC_DelSig_DEC__SR EQU CYREG_DEC_SR
ADC_DelSig_DEC__TRIM__M1 EQU CYREG_FLSHID_CUST_TABLES_DEC_M1
ADC_DelSig_DEC__TRIM__M2 EQU CYREG_FLSHID_CUST_TABLES_DEC_M2
ADC_DelSig_DEC__TRIM__M3 EQU CYREG_FLSHID_CUST_TABLES_DEC_M3
ADC_DelSig_DEC__TRIM__M4 EQU CYREG_FLSHID_CUST_TABLES_DEC_M4
ADC_DelSig_DEC__TRIM__M5 EQU CYREG_FLSHID_CUST_TABLES_DEC_M5
ADC_DelSig_DEC__TRIM__M6 EQU CYREG_FLSHID_CUST_TABLES_DEC_M6
ADC_DelSig_DEC__TRIM__M7 EQU CYREG_FLSHID_CUST_TABLES_DEC_M7
ADC_DelSig_DEC__TRIM__M8 EQU CYREG_FLSHID_CUST_TABLES_DEC_M8
ADC_DelSig_DSM__BUF0 EQU CYREG_DSM0_BUF0
ADC_DelSig_DSM__BUF1 EQU CYREG_DSM0_BUF1
ADC_DelSig_DSM__BUF2 EQU CYREG_DSM0_BUF2
ADC_DelSig_DSM__BUF3 EQU CYREG_DSM0_BUF3
ADC_DelSig_DSM__CLK EQU CYREG_DSM0_CLK
ADC_DelSig_DSM__CR0 EQU CYREG_DSM0_CR0
ADC_DelSig_DSM__CR1 EQU CYREG_DSM0_CR1
ADC_DelSig_DSM__CR10 EQU CYREG_DSM0_CR10
ADC_DelSig_DSM__CR11 EQU CYREG_DSM0_CR11
ADC_DelSig_DSM__CR12 EQU CYREG_DSM0_CR12
ADC_DelSig_DSM__CR13 EQU CYREG_DSM0_CR13
ADC_DelSig_DSM__CR14 EQU CYREG_DSM0_CR14
ADC_DelSig_DSM__CR15 EQU CYREG_DSM0_CR15
ADC_DelSig_DSM__CR16 EQU CYREG_DSM0_CR16
ADC_DelSig_DSM__CR17 EQU CYREG_DSM0_CR17
ADC_DelSig_DSM__CR2 EQU CYREG_DSM0_CR2
ADC_DelSig_DSM__CR3 EQU CYREG_DSM0_CR3
ADC_DelSig_DSM__CR4 EQU CYREG_DSM0_CR4
ADC_DelSig_DSM__CR5 EQU CYREG_DSM0_CR5
ADC_DelSig_DSM__CR6 EQU CYREG_DSM0_CR6
ADC_DelSig_DSM__CR7 EQU CYREG_DSM0_CR7
ADC_DelSig_DSM__CR8 EQU CYREG_DSM0_CR8
ADC_DelSig_DSM__CR9 EQU CYREG_DSM0_CR9
ADC_DelSig_DSM__DEM0 EQU CYREG_DSM0_DEM0
ADC_DelSig_DSM__DEM1 EQU CYREG_DSM0_DEM1
ADC_DelSig_DSM__MISC EQU CYREG_DSM0_MISC
ADC_DelSig_DSM__OUT0 EQU CYREG_DSM0_OUT0
ADC_DelSig_DSM__OUT1 EQU CYREG_DSM0_OUT1
ADC_DelSig_DSM__REF0 EQU CYREG_DSM0_REF0
ADC_DelSig_DSM__REF1 EQU CYREG_DSM0_REF1
ADC_DelSig_DSM__REF2 EQU CYREG_DSM0_REF2
ADC_DelSig_DSM__REF3 EQU CYREG_DSM0_REF3
ADC_DelSig_DSM__RSVD1 EQU CYREG_DSM0_RSVD1
ADC_DelSig_DSM__SW0 EQU CYREG_DSM0_SW0
ADC_DelSig_DSM__SW2 EQU CYREG_DSM0_SW2
ADC_DelSig_DSM__SW3 EQU CYREG_DSM0_SW3
ADC_DelSig_DSM__SW4 EQU CYREG_DSM0_SW4
ADC_DelSig_DSM__SW6 EQU CYREG_DSM0_SW6
ADC_DelSig_DSM__TR0 EQU CYREG_NPUMP_DSM_TR0
ADC_DelSig_DSM__TST0 EQU CYREG_DSM0_TST0
ADC_DelSig_DSM__TST1 EQU CYREG_DSM0_TST1
ADC_DelSig_Ext_CP_Clk__CFG0 EQU CYREG_CLKDIST_DCFG0_CFG0
ADC_DelSig_Ext_CP_Clk__CFG1 EQU CYREG_CLKDIST_DCFG0_CFG1
ADC_DelSig_Ext_CP_Clk__CFG2 EQU CYREG_CLKDIST_DCFG0_CFG2
ADC_DelSig_Ext_CP_Clk__CFG2_SRC_SEL_MASK EQU 0x07
ADC_DelSig_Ext_CP_Clk__INDEX EQU 0x00
ADC_DelSig_Ext_CP_Clk__PM_ACT_CFG EQU CYREG_PM_ACT_CFG2
ADC_DelSig_Ext_CP_Clk__PM_ACT_MSK EQU 0x01
ADC_DelSig_Ext_CP_Clk__PM_STBY_CFG EQU CYREG_PM_STBY_CFG2
ADC_DelSig_Ext_CP_Clk__PM_STBY_MSK EQU 0x01
ADC_DelSig_IRQ__INTC_CLR_EN_REG EQU CYREG_NVIC_CLRENA0
ADC_DelSig_IRQ__INTC_CLR_PD_REG EQU CYREG_NVIC_CLRPEND0
ADC_DelSig_IRQ__INTC_MASK EQU 0x20000000
ADC_DelSig_IRQ__INTC_NUMBER EQU 29
ADC_DelSig_IRQ__INTC_PRIOR_NUM EQU 7
ADC_DelSig_IRQ__INTC_PRIOR_REG EQU CYREG_NVIC_PRI_29
ADC_DelSig_IRQ__INTC_SET_EN_REG EQU CYREG_NVIC_SETENA0
ADC_DelSig_IRQ__INTC_SET_PD_REG EQU CYREG_NVIC_SETPEND0
ADC_DelSig_theACLK__CFG0 EQU CYREG_CLKDIST_ACFG0_CFG0
ADC_DelSig_theACLK__CFG1 EQU CYREG_CLKDIST_ACFG0_CFG1
ADC_DelSig_theACLK__CFG2 EQU CYREG_CLKDIST_ACFG0_CFG2
ADC_DelSig_theACLK__CFG2_SRC_SEL_MASK EQU 0x07
ADC_DelSig_theACLK__CFG3 EQU CYREG_CLKDIST_ACFG0_CFG3
ADC_DelSig_theACLK__CFG3_PHASE_DLY_MASK EQU 0x0F
ADC_DelSig_theACLK__INDEX EQU 0x00
ADC_DelSig_theACLK__PM_ACT_CFG EQU CYREG_PM_ACT_CFG1
ADC_DelSig_theACLK__PM_ACT_MSK EQU 0x01
ADC_DelSig_theACLK__PM_STBY_CFG EQU CYREG_PM_STBY_CFG1
ADC_DelSig_theACLK__PM_STBY_MSK EQU 0x01

; Pin_RedLED
Pin_RedLED__0__INTTYPE EQU CYREG_PICU2_INTTYPE7
Pin_RedLED__0__MASK EQU 0x80
Pin_RedLED__0__PC EQU CYREG_PRT2_PC7
Pin_RedLED__0__PORT EQU 2
Pin_RedLED__0__SHIFT EQU 7
Pin_RedLED__AG EQU CYREG_PRT2_AG
Pin_RedLED__AMUX EQU CYREG_PRT2_AMUX
Pin_RedLED__BIE EQU CYREG_PRT2_BIE
Pin_RedLED__BIT_MASK EQU CYREG_PRT2_BIT_MASK
Pin_RedLED__BYP EQU CYREG_PRT2_BYP
Pin_RedLED__CTL EQU CYREG_PRT2_CTL
Pin_RedLED__DM0 EQU CYREG_PRT2_DM0
Pin_RedLED__DM1 EQU CYREG_PRT2_DM1
Pin_RedLED__DM2 EQU CYREG_PRT2_DM2
Pin_RedLED__DR EQU CYREG_PRT2_DR
Pin_RedLED__INP_DIS EQU CYREG_PRT2_INP_DIS
Pin_RedLED__INTTYPE_BASE EQU CYDEV_PICU_INTTYPE_PICU2_BASE
Pin_RedLED__LCD_COM_SEG EQU CYREG_PRT2_LCD_COM_SEG
Pin_RedLED__LCD_EN EQU CYREG_PRT2_LCD_EN
Pin_RedLED__MASK EQU 0x80
Pin_RedLED__PORT EQU 2
Pin_RedLED__PRT EQU CYREG_PRT2_PRT
Pin_RedLED__PRTDSI__CAPS_SEL EQU CYREG_PRT2_CAPS_SEL
Pin_RedLED__PRTDSI__DBL_SYNC_IN EQU CYREG_PRT2_DBL_SYNC_IN
Pin_RedLED__PRTDSI__OE_SEL0 EQU CYREG_PRT2_OE_SEL0
Pin_RedLED__PRTDSI__OE_SEL1 EQU CYREG_PRT2_OE_SEL1
Pin_RedLED__PRTDSI__OUT_SEL0 EQU CYREG_PRT2_OUT_SEL0
Pin_RedLED__PRTDSI__OUT_SEL1 EQU CYREG_PRT2_OUT_SEL1
Pin_RedLED__PRTDSI__SYNC_OUT EQU CYREG_PRT2_SYNC_OUT
Pin_RedLED__PS EQU CYREG_PRT2_PS
Pin_RedLED__SHIFT EQU 7
Pin_RedLED__SLW EQU CYREG_PRT2_SLW

; Pin_GreenLED
Pin_GreenLED__0__INTTYPE EQU CYREG_PICU2_INTTYPE5
Pin_GreenLED__0__MASK EQU 0x20
Pin_GreenLED__0__PC EQU CYREG_PRT2_PC5
Pin_GreenLED__0__PORT EQU 2
Pin_GreenLED__0__SHIFT EQU 5
Pin_GreenLED__AG EQU CYREG_PRT2_AG
Pin_GreenLED__AMUX EQU CYREG_PRT2_AMUX
Pin_GreenLED__BIE EQU CYREG_PRT2_BIE
Pin_GreenLED__BIT_MASK EQU CYREG_PRT2_BIT_MASK
Pin_GreenLED__BYP EQU CYREG_PRT2_BYP
Pin_GreenLED__CTL EQU CYREG_PRT2_CTL
Pin_GreenLED__DM0 EQU CYREG_PRT2_DM0
Pin_GreenLED__DM1 EQU CYREG_PRT2_DM1
Pin_GreenLED__DM2 EQU CYREG_PRT2_DM2
Pin_GreenLED__DR EQU CYREG_PRT2_DR
Pin_GreenLED__INP_DIS EQU CYREG_PRT2_INP_DIS
Pin_GreenLED__INTTYPE_BASE EQU CYDEV_PICU_INTTYPE_PICU2_BASE
Pin_GreenLED__LCD_COM_SEG EQU CYREG_PRT2_LCD_COM_SEG
Pin_GreenLED__LCD_EN EQU CYREG_PRT2_LCD_EN
Pin_GreenLED__MASK EQU 0x20
Pin_GreenLED__PORT EQU 2
Pin_GreenLED__PRT EQU CYREG_PRT2_PRT
Pin_GreenLED__PRTDSI__CAPS_SEL EQU CYREG_PRT2_CAPS_SEL
Pin_GreenLED__PRTDSI__DBL_SYNC_IN EQU CYREG_PRT2_DBL_SYNC_IN
Pin_GreenLED__PRTDSI__OE_SEL0 EQU CYREG_PRT2_OE_SEL0
Pin_GreenLED__PRTDSI__OE_SEL1 EQU CYREG_PRT2_OE_SEL1
Pin_GreenLED__PRTDSI__OUT_SEL0 EQU CYREG_PRT2_OUT_SEL0
Pin_GreenLED__PRTDSI__OUT_SEL1 EQU CYREG_PRT2_OUT_SEL1
Pin_GreenLED__PRTDSI__SYNC_OUT EQU CYREG_PRT2_SYNC_OUT
Pin_GreenLED__PS EQU CYREG_PRT2_PS
Pin_GreenLED__SHIFT EQU 5
Pin_GreenLED__SLW EQU CYREG_PRT2_SLW

; Pin_YellowLED
Pin_YellowLED__0__INTTYPE EQU CYREG_PICU2_INTTYPE6
Pin_YellowLED__0__MASK EQU 0x40
Pin_YellowLED__0__PC EQU CYREG_PRT2_PC6
Pin_YellowLED__0__PORT EQU 2
Pin_YellowLED__0__SHIFT EQU 6
Pin_YellowLED__AG EQU CYREG_PRT2_AG
Pin_YellowLED__AMUX EQU CYREG_PRT2_AMUX
Pin_YellowLED__BIE EQU CYREG_PRT2_BIE
Pin_YellowLED__BIT_MASK EQU CYREG_PRT2_BIT_MASK
Pin_YellowLED__BYP EQU CYREG_PRT2_BYP
Pin_YellowLED__CTL EQU CYREG_PRT2_CTL
Pin_YellowLED__DM0 EQU CYREG_PRT2_DM0
Pin_YellowLED__DM1 EQU CYREG_PRT2_DM1
Pin_YellowLED__DM2 EQU CYREG_PRT2_DM2
Pin_YellowLED__DR EQU CYREG_PRT2_DR
Pin_YellowLED__INP_DIS EQU CYREG_PRT2_INP_DIS
Pin_YellowLED__INTTYPE_BASE EQU CYDEV_PICU_INTTYPE_PICU2_BASE
Pin_YellowLED__LCD_COM_SEG EQU CYREG_PRT2_LCD_COM_SEG
Pin_YellowLED__LCD_EN EQU CYREG_PRT2_LCD_EN
Pin_YellowLED__MASK EQU 0x40
Pin_YellowLED__PORT EQU 2
Pin_YellowLED__PRT EQU CYREG_PRT2_PRT
Pin_YellowLED__PRTDSI__CAPS_SEL EQU CYREG_PRT2_CAPS_SEL
Pin_YellowLED__PRTDSI__DBL_SYNC_IN EQU CYREG_PRT2_DBL_SYNC_IN
Pin_YellowLED__PRTDSI__OE_SEL0 EQU CYREG_PRT2_OE_SEL0
Pin_YellowLED__PRTDSI__OE_SEL1 EQU CYREG_PRT2_OE_SEL1
Pin_YellowLED__PRTDSI__OUT_SEL0 EQU CYREG_PRT2_OUT_SEL0
Pin_YellowLED__PRTDSI__OUT_SEL1 EQU CYREG_PRT2_OUT_SEL1
Pin_YellowLED__PRTDSI__SYNC_OUT EQU CYREG_PRT2_SYNC_OUT
Pin_YellowLED__PS EQU CYREG_PRT2_PS
Pin_YellowLED__SHIFT EQU 6
Pin_YellowLED__SLW EQU CYREG_PRT2_SLW

; Miscellaneous
BCLK__BUS_CLK__HZ EQU 24000000
BCLK__BUS_CLK__KHZ EQU 24000
BCLK__BUS_CLK__MHZ EQU 24
CYDEV_CHIP_DIE_LEOPARD EQU 1
CYDEV_CHIP_DIE_PSOC4A EQU 18
CYDEV_CHIP_DIE_PSOC5LP EQU 2
CYDEV_CHIP_DIE_PSOC5TM EQU 3
CYDEV_CHIP_DIE_TMA4 EQU 4
CYDEV_CHIP_DIE_UNKNOWN EQU 0
CYDEV_CHIP_FAMILY_FM0P EQU 5
CYDEV_CHIP_FAMILY_FM3 EQU 6
CYDEV_CHIP_FAMILY_FM4 EQU 7
CYDEV_CHIP_FAMILY_PSOC3 EQU 1
CYDEV_CHIP_FAMILY_PSOC4 EQU 2
CYDEV_CHIP_FAMILY_PSOC5 EQU 3
CYDEV_CHIP_FAMILY_PSOC6 EQU 4
CYDEV_CHIP_FAMILY_UNKNOWN EQU 0
CYDEV_CHIP_FAMILY_USED EQU CYDEV_CHIP_FAMILY_PSOC5
CYDEV_CHIP_JTAG_ID EQU 0x2E160069
CYDEV_CHIP_MEMBER_3A EQU 1
CYDEV_CHIP_MEMBER_4A EQU 18
CYDEV_CHIP_MEMBER_4D EQU 13
CYDEV_CHIP_MEMBER_4E EQU 6
CYDEV_CHIP_MEMBER_4F EQU 19
CYDEV_CHIP_MEMBER_4G EQU 4
CYDEV_CHIP_MEMBER_4H EQU 17
CYDEV_CHIP_MEMBER_4I EQU 23
CYDEV_CHIP_MEMBER_4J EQU 14
CYDEV_CHIP_MEMBER_4K EQU 15
CYDEV_CHIP_MEMBER_4L EQU 22
CYDEV_CHIP_MEMBER_4M EQU 21
CYDEV_CHIP_MEMBER_4N EQU 10
CYDEV_CHIP_MEMBER_4O EQU 7
CYDEV_CHIP_MEMBER_4P EQU 20
CYDEV_CHIP_MEMBER_4Q EQU 12
CYDEV_CHIP_MEMBER_4R EQU 8
CYDEV_CHIP_MEMBER_4S EQU 11
CYDEV_CHIP_MEMBER_4T EQU 9
CYDEV_CHIP_MEMBER_4U EQU 5
CYDEV_CHIP_MEMBER_4V EQU 16
CYDEV_CHIP_MEMBER_5A EQU 3
CYDEV_CHIP_MEMBER_5B EQU 2
CYDEV_CHIP_MEMBER_6A EQU 24
CYDEV_CHIP_MEMBER_FM3 EQU 28
CYDEV_CHIP_MEMBER_FM4 EQU 29
CYDEV_CHIP_MEMBER_PDL_FM0P_TYPE1 EQU 25
CYDEV_CHIP_MEMBER_PDL_FM0P_TYPE2 EQU 26
CYDEV_CHIP_MEMBER_PDL_FM0P_TYPE3 EQU 27
CYDEV_CHIP_MEMBER_UNKNOWN EQU 0
CYDEV_CHIP_MEMBER_USED EQU CYDEV_CHIP_MEMBER_5B
CYDEV_CHIP_DIE_EXPECT EQU CYDEV_CHIP_MEMBER_USED
CYDEV_CHIP_DIE_ACTUAL EQU CYDEV_CHIP_DIE_EXPECT
CYDEV_CHIP_REV_LEOPARD_ES1 EQU 0
CYDEV_CHIP_REV_LEOPARD_ES2 EQU 1
CYDEV_CHIP_REV_LEOPARD_ES3 EQU 3
CYDEV_CHIP_REV_LEOPARD_PRODUCTION EQU 3
CYDEV_CHIP_REV_PSOC4A_ES0 EQU 17
CYDEV_CHIP_REV_PSOC4A_PRODUCTION EQU 17
CYDEV_CHIP_REV_PSOC5LP_ES0 EQU 0
CYDEV_CHIP_REV_PSOC5LP_PRODUCTION EQU 0
CYDEV_CHIP_REV_PSOC5TM_ES0 EQU 0
CYDEV_CHIP_REV_PSOC5TM_ES1 EQU 1
CYDEV_CHIP_REV_PSOC5TM_PRODUCTION EQU 1
CYDEV_CHIP_REV_TMA4_ES EQU 17
CYDEV_CHIP_REV_TMA4_ES2 EQU 33
CYDEV_CHIP_REV_TMA4_PRODUCTION EQU 17
CYDEV_CHIP_REVISION_3A_ES1 EQU 0
CYDEV_CHIP_REVISION_3A_ES2 EQU 1
CYDEV_CHIP_REVISION_3A_ES3 EQU 3
CYDEV_CHIP_REVISION_3A_PRODUCTION EQU 3
CYDEV_CHIP_REVISION_4A_ES0 EQU 17
CYDEV_CHIP_REVISION_4A_PRODUCTION EQU 17
CYDEV_CHIP_REVISION_4D_PRODUCTION EQU 0
CYDEV_CHIP_REVISION_4E_CCG2_NO_USBPD EQU 0
CYDEV_CHIP_REVISION_4E_PRODUCTION EQU 0
CYDEV_CHIP_REVISION_4F_PRODUCTION EQU 0
CYDEV_CHIP_REVISION_4F_PRODUCTION_256DMA EQU 0
CYDEV_CHIP_REVISION_4F_PRODUCTION_256K EQU 0
CYDEV_CHIP_REVISION_4G_ES EQU 17
CYDEV_CHIP_REVISION_4G_ES2 EQU 33
CYDEV_CHIP_REVISION_4G_PRODUCTION EQU 17
CYDEV_CHIP_REVISION_4H_PRODUCTION EQU 0
CYDEV_CHIP_REVISION_4I_PRODUCTION EQU 0
CYDEV_CHIP_REVISION_4J_PRODUCTION EQU 0
CYDEV_CHIP_REVISION_4K_PRODUCTION EQU 0
CYDEV_CHIP_REVISION_4L_PRODUCTION EQU 0
CYDEV_CHIP_REVISION_4M_PRODUCTION EQU 0
CYDEV_CHIP_REVISION_4N_PRODUCTION EQU 0
CYDEV_CHIP_REVISION_4O_PRODUCTION EQU 0
CYDEV_CHIP_REVISION_4P_PRODUCTION EQU 0
CYDEV_CHIP_REVISION_4Q_PRODUCTION EQU 0
CYDEV_CHIP_REVISION_4R_PRODUCTION EQU 0
CYDEV_CHIP_REVISION_4S_PRODUCTION EQU 0
CYDEV_CHIP_REVISION_4T_PRODUCTION EQU 0
CYDEV_CHIP_REVISION_4U_PRODUCTION EQU 0
CYDEV_CHIP_REVISION_4V_PRODUCTION EQU 0
CYDEV_CHIP_REVISION_5A_ES0 EQU 0
CYDEV_CHIP_REVISION_5A_ES1 EQU 1
CYDEV_CHIP_REVISION_5A_PRODUCTION EQU 1
CYDEV_CHIP_REVISION_5B_ES0 EQU 0
CYDEV_CHIP_REVISION_5B_PRODUCTION EQU 0
CYDEV_CHIP_REVISION_6A_ES EQU 17
CYDEV_CHIP_REVISION_6A_NO_UDB EQU 33
CYDEV_CHIP_REVISION_6A_PRODUCTION EQU 33
CYDEV_CHIP_REVISION_FM3_PRODUCTION EQU 0
CYDEV_CHIP_REVISION_FM4_PRODUCTION EQU 0
CYDEV_CHIP_REVISION_PDL_FM0P_TYPE1_PRODUCTION EQU 0
CYDEV_CHIP_REVISION_PDL_FM0P_TYPE2_PRODUCTION EQU 0
CYDEV_CHIP_REVISION_PDL_FM0P_TYPE3_PRODUCTION EQU 0
CYDEV_CHIP_REVISION_USED EQU CYDEV_CHIP_REVISION_5B_PRODUCTION
CYDEV_CHIP_REV_EXPECT EQU CYDEV_CHIP_REVISION_USED
CYDEV_CONFIG_FASTBOOT_ENABLED EQU 1
CYDEV_CONFIG_UNUSED_IO_AllowButWarn EQU 0
CYDEV_CONFIG_UNUSED_IO EQU CYDEV_CONFIG_UNUSED_IO_AllowButWarn
CYDEV_CONFIG_UNUSED_IO_AllowWithInfo EQU 1
CYDEV_CONFIG_UNUSED_IO_Disallowed EQU 2
CYDEV_CONFIGURATION_COMPRESSED EQU 1
CYDEV_CONFIGURATION_DMA EQU 0
CYDEV_CONFIGURATION_ECC EQU 1
CYDEV_CONFIGURATION_IMOENABLED EQU CYDEV_CONFIG_FASTBOOT_ENABLED
CYDEV_CONFIGURATION_MODE_COMPRESSED EQU 0
CYDEV_CONFIGURATION_MODE EQU CYDEV_CONFIGURATION_MODE_COMPRESSED
CYDEV_CONFIGURATION_MODE_DMA EQU 2
CYDEV_CONFIGURATION_MODE_UNCOMPRESSED EQU 1
CYDEV_DEBUG_ENABLE_MASK EQU 0x20
CYDEV_DEBUG_ENABLE_REGISTER EQU CYREG_MLOGIC_DEBUG
CYDEV_DEBUGGING_DPS_Disable EQU 3
CYDEV_DEBUGGING_DPS_JTAG_4 EQU 1
CYDEV_DEBUGGING_DPS_JTAG_5 EQU 0
CYDEV_DEBUGGING_DPS_SWD EQU 2
CYDEV_DEBUGGING_DPS_SWD_SWV EQU 6
CYDEV_DEBUGGING_DPS EQU CYDEV_DEBUGGING_DPS_SWD_SWV
CYDEV_DEBUGGING_ENABLE EQU 1
CYDEV_DEBUGGING_XRES EQU 0
CYDEV_DMA_CHANNELS_AVAILABLE EQU 24
CYDEV_ECC_ENABLE EQU 0
CYDEV_HEAP_SIZE EQU 0x80
CYDEV_INSTRUCT_CACHE_ENABLED EQU 1
CYDEV_INTR_RISING EQU 0x00000007
CYDEV_IS_EXPORTING_CODE EQU 0
CYDEV_IS_IMPORTING_CODE EQU 0
CYDEV_PROJ_TYPE EQU 0
CYDEV_PROJ_TYPE_BOOTLOADER EQU 1
CYDEV_PROJ_TYPE_LAUNCHER EQU 5
CYDEV_PROJ_TYPE_LOADABLE EQU 2
CYDEV_PROJ_TYPE_LOADABLEANDBOOTLOADER EQU 4
CYDEV_PROJ_TYPE_MULTIAPPBOOTLOADER EQU 3
CYDEV_PROJ_TYPE_STANDARD EQU 0
CYDEV_PROTECTION_ENABLE EQU 0
CYDEV_STACK_SIZE EQU 0x0800
CYDEV_USE_BUNDLED_CMSIS EQU 1
CYDEV_VARIABLE_VDDA EQU 0
CYDEV_VDDA_MV EQU 5000
CYDEV_VDDD_MV EQU 5000
CYDEV_VDDIO0_MV EQU 5000
CYDEV_VDDIO1_MV EQU 5000
CYDEV_VDDIO2_MV EQU 5000
CYDEV_VDDIO3_MV EQU 5000
CYDEV_VIO0_MV EQU 5000
CYDEV_VIO1_MV EQU 5000
CYDEV_VIO2_MV EQU 5000
CYDEV_VIO3_MV EQU 5000
CYIPBLOCK_ARM_CM3_VERSION EQU 0
CYIPBLOCK_P3_ANAIF_VERSION EQU 0
CYIPBLOCK_P3_CAN_VERSION EQU 0
CYIPBLOCK_P3_CAPSENSE_VERSION EQU 0
CYIPBLOCK_P3_COMP_VERSION EQU 0
CYIPBLOCK_P3_DECIMATOR_VERSION EQU 0
CYIPBLOCK_P3_DFB_VERSION EQU 0
CYIPBLOCK_P3_DMA_VERSION EQU 0
CYIPBLOCK_P3_DRQ_VERSION EQU 0
CYIPBLOCK_P3_DSM_VERSION EQU 0
CYIPBLOCK_P3_EMIF_VERSION EQU 0
CYIPBLOCK_P3_I2C_VERSION EQU 0
CYIPBLOCK_P3_LCD_VERSION EQU 0
CYIPBLOCK_P3_LPF_VERSION EQU 0
CYIPBLOCK_P3_OPAMP_VERSION EQU 0
CYIPBLOCK_P3_PM_VERSION EQU 0
CYIPBLOCK_P3_SCCT_VERSION EQU 0
CYIPBLOCK_P3_TIMER_VERSION EQU 0
CYIPBLOCK_P3_USB_VERSION EQU 0
CYIPBLOCK_P3_VIDAC_VERSION EQU 0
CYIPBLOCK_P3_VREF_VERSION EQU 0
CYIPBLOCK_S8_GPIO_VERSION EQU 0
CYIPBLOCK_S8_IRQ_VERSION EQU 0
CYIPBLOCK_S8_SAR_VERSION EQU 0
CYIPBLOCK_S8_SIO_VERSION EQU 0
CYIPBLOCK_S8_UDB_VERSION EQU 0
CYDEV_BOOTLOADER_ENABLE EQU 0
    ENDIF
    END
